## conf/layer.conf
```bitbake
# We have a conf and classes directory, add to BBPATH
BBPATH .= ":${LAYERDIR}"

# We have recipes-* directories, add to BBFILES
BBFILES += "${LAYERDIR}/recipes-*/*/*.bb \
            ${LAYERDIR}/recipes-*/*/*.bbappend"

BBFILE_COLLECTIONS += "meta-jooc"
BBFILE_PATTERN_meta-jooc = "^${LAYERDIR}/"
BBFILE_PRIORITY_meta-jooc = "6"

LAYERDEPENDS_meta-jooc = "core"
LAYERSERIES_COMPAT_meta-jooc = "kirkstone"
```
